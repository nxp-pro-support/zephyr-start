## app/demos/ethernet_bridge/bridge/boards/frdm_rw612.conf
```kconfig
# IPv4 addresses are assigned in main.c (iface_set_static), not via Kconfig.

CONFIG_SHELL=y
CONFIG_SHELL_BACKEND_SERIAL=y
CONFIG_NET_SHELL=y


CONFIG_ETH_LAN865X_IRQ_THREAD_STACK_SIZE=2048
CONFIG_DMA=y
CONFIG_SPI_MCUX_FLEXCOMM_DMA=y

# Disable ENET hardware checksum offload. With bridging, frames are L2-forwarded
# with checksums already computed by the origin; the ENET TX checksum-insertion
# engine would recompute and CORRUPT them (e.g. bridged ICMP replies egressing
# RJ45 get a bad checksum and the peer drops them). Off -> software checksums,
# and forwarded frames pass through untouched.
CONFIG_ETH_NXP_ENET_HW_ACCELERATION=n


CONFIG_NET_ETHERNET_BRIDGE_ETH_INTERFACE_COUNT=5
CONFIG_NET_IF_MAX_IPV4_COUNT=8
CONFIG_NET_IF_MAX_IPV6_COUNT=8




CONFIG_NETWORKING=y
CONFIG_NET_L2_ETHERNET=y
CONFIG_NET_IPV6=n
CONFIG_NET_IPV4=y
CONFIG_NET_ARP=y
CONFIG_NET_UDP=y
CONFIG_NET_TCP=n
CONFIG_NET_SOCKETS=y

CONFIG_NET_MGMT=y
CONFIG_NET_MGMT_EVENT=y

# Addresses come from main.c, so disable the Kconfig static-IP path and DHCP
# to avoid them assigning competing addresses at boot.
CONFIG_NET_CONFIG_SETTINGS=n
CONFIG_NET_DHCPV4=n

CONFIG_ETH_LAN865X=y

CONFIG_TEST_RANDOM_GENERATOR=y

CONFIG_MAIN_STACK_SIZE=3072
CONFIG_SYSTEM_WORKQUEUE_STACK_SIZE=2048
CONFIG_HEAP_MEM_POOL_SIZE=4096

CONFIG_NET_PKT_RX_COUNT=8
CONFIG_NET_PKT_TX_COUNT=8
CONFIG_NET_BUF_RX_COUNT=24
CONFIG_NET_BUF_TX_COUNT=24
CONFIG_NET_BUF_DATA_SIZE=128
CONFIG_NET_MAX_CONTEXTS=6

CONFIG_LOG=y
CONFIG_PRINTK=y
CONFIG_LOG_DEFAULT_LEVEL=3



#CONFIG_NET_ETHERNET_BRIDGE=y
#CONFIG_NET_ETHERNET_BRIDGE_SHELL=y
#CONFIG_NET_ETHERNET_BRIDGE_LOG_LEVEL_DBG=y
```

## boards/nxp/rt1050_custom/Kconfig.defconfig
```kconfig
# RT1050 Custom board

# Copyright (c) 2017, NXP
# SPDX-License-Identifier: Apache-2.0

if BOARD_RT1050_CUSTOM

config DEVICE_CONFIGURATION_DATA
	default y

config NXP_IMX_EXTERNAL_SDRAM
	default y

if NETWORKING

config NET_L2_ETHERNET
	default y

endif # NETWORKING

endif # BOARD_RT1050_CUSTOM
```

## boards/nxp/rt1050_custom/Kconfig.rt1050_custom
```kconfig
# Copyright (c) 2017, NXP
# SPDX-License-Identifier: Apache-2.0

config BOARD_RT1050_CUSTOM
	select SOC_PART_NUMBER_MIMXRT1052DVL6B
```

## boards/nxp/rt1050_custom/board.yml
```yaml
board:
  name: rt1050_custom
  full_name: RT1050 Custom
  vendor: nxp
  socs:
    - name: mimxrt1052
```

## demos/lan8651_t1s_demo/Kconfig
```kconfig
mainmenu "LAN8651 T1S Demo"

menu "LAN8651 T1S Demo"

config APP_UDP_PORT
	int "UDP echo port"
	default 4242
	range 1 65535

config APP_SERVER_STACK_SIZE
	int "Server thread stack size"
	default 2048
	range 1024 8192

config APP_HTTP_SERVER
	bool "Enable simple HTTP status server"
	help
	  Start a small TCP-based HTTP status server in addition to the UDP echo
	  server. This is intended as a footprint experiment, not a production
	  web stack.

config APP_HTTP_PORT
	int "HTTP status server port"
	default 8080
	range 1 65535
	depends on APP_HTTP_SERVER

config APP_HTTP_MAX_REQUEST
	int "Maximum HTTP request buffer size"
	default 512
	range 128 2048
	depends on APP_HTTP_SERVER

endmenu

source "Kconfig.zephyr"
```

## west.yml
```yaml
manifest:
  defaults:
    remote: zephyrproject-rtos
    revision: main

  remotes:
    - name: zephyrproject-rtos
      url-base: https://github.com/zephyrproject-rtos

    - name: nxp-pro-support
      url-base: https://github.com/nxp-pro-support
      
    - name: wn
      url-base: https://github.com/wavenumber-eng

  projects:

    - name: zephyr
      remote: zephyrproject-rtos
      repo-path: zephyr
      revision: v4.3.0
      import:
        name-allowlist:
          - cmsis
          - cmsis_6
          - hal_nxp
          - liblc3
          - libmetal
          - littlefs
          - mbedtls
          - lvgl
          - open-amp
          - segger

    - name: zephyr-module-sample
      remote: nxp-pro-support
      repo-path: zephyr-module-sample
      revision: main
      path: ./modules/module-sample

    - name: zephyr-custom-board-sample
      remote: nxp-pro-support
      repo-path: zephyr-custom-board-sample
      revision: main
      path: ./custom-boards/
      
    - name: wn_zephyr_modules   
      remote: wn    
      path: ./modules/wn_modules     
      revision: main
     
    - name: bunny_build
      remote: wn
      revision: main
      path: modules/bunny_build
      

  self:
    path: app
    
```
