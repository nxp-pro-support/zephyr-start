## prj.conf
```kconfig
CONFIG_LOG=y
CONFIG_SHELL=y
CONFIG_GPIO=y

CONFIG_RT_CONFIG=y
CONFIG_RT_CONFIG_USE_NVS=y
CONFIG_FLASH_MAP=y

CONFIG_REBOOT=y

CONFIG_NO_OPTIMIZATIONS=y
CONFIG_MAIN_STACK_SIZE=8192
CONFIG_SYSTEM_WORKQUEUE_STACK_SIZE=8192
CONFIG_ISR_STACK_SIZE=2048
```

## src/main.c
```c
#include <zephyr/kernel.h>
#include <zephyr/logging/log.h>
#include <zephyr/shell/shell.h>
#include <rt_config.h>

uint32_t main_sleep_time;

RT_CONFIG_ITEM(main_sleep,
              "milliseconds the main thread should sleep for", 
               &main_sleep_time, 
               RT_CONFIG_DATA_TYPE_UINT32, 
               sizeof(main_sleep_time),
               "10",   //Min
               "5000", //max
               "500"); //Default

int main(void)
{
    while (1)
    {   
        k_sleep(K_MSEC(main_sleep_time));
    }
    
	return 0;
}
```

## src/t2.c
```c
#include <zephyr/kernel.h>
#include <zephyr/logging/log.h>
#include <zephyr/drivers/gpio.h>
#include "rt_config.h"

uint32_t t2_sleep_time;

RT_CONFIG_ITEM(t2_sleep,
              "milliseconds thread t2 should sleep for", 
               &t2_sleep_time, 
               RT_CONFIG_DATA_TYPE_UINT32, 
               sizeof(t2_sleep_time),
               "10",  //Min
               "5000", //max
               "500"); //Default


// Thread configurations
#define CONFIG__T2_TH_STACK_SIZE 2048
#define CONFIG__T2_TH_PRIORITY 5

void t2_thread_task(void *, void *, void *);

K_THREAD_DEFINE(t2_thread, CONFIG__T2_TH_STACK_SIZE,
                t2_thread_task, NULL, NULL, NULL,
                CONFIG__T2_TH_PRIORITY, 0, 0);

LOG_MODULE_REGISTER(t2);


// GPIO configurations
#define LED0_NODE DT_ALIAS(led0)
static const struct gpio_dt_spec led = GPIO_DT_SPEC_GET(LED0_NODE, gpios);


void t2_thread_task(void *, void *, void *)
{
    gpio_pin_configure_dt(&led, GPIO_OUTPUT_ACTIVE);

    while (1)
    {

        gpio_pin_toggle_dt(&led);

        k_sleep(K_MSEC(t2_sleep_time));
    }
}
```
